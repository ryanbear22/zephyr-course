## app/Kconfig
```kconfig
menuconfig LED_SUBSYSTEM
    bool "LED Subsystem"
    default n

if LED_SUBSYSTEM

config BLINK_SLEEP_TIME_MS
    int
    default 250 if BLINK_SLEEP_250MS
    default 500 if BLINK_SLEEP_500MS
    default 1000 if BLINK_SLEEP_1000MS
    default 2000 if BLINK_SLEEP_2000MS
    default 0

choice
    prompt "LED blink sleep time"
    default BLINK_SLEEP_1000MS
config BLINK_SLEEP_250MS
    bool "250ms (fast)"
config BLINK_SLEEP_500MS
    bool "500ms (quick)"
config BLINK_SLEEP_1000MS
    bool "1s (medium)"
config BLINK_SLEEP_2000MS
    bool "2s (slow)"
endchoice

menuconfig ADVANCE_LED_SETTINGS
    bool "Advance LED settings"
    default n

if ADVANCE_LED_SETTINGS

config LED_BRIGHTNESS
    int "Led Brightness (0-100)"
    range 0 100
    default 100
config LED_FADE_DURATION_MS
    int "LED fade duration (ms)"
    range 0 5000
    default 500

menu "Expert settings"
    visible if ADVANCE_LED_SETTINGS
config LED_DEBUGGING
    bool "Enable LED debugging"
    default 0
config LED_BLINK_CUSTOM
    bool "Custom blink pattern"
    default 0
endmenu # EXPERT SETTINGS

endif # ADVANCE_LED_SETTINGS

endif # LED_SUBSYSTEM

source "Kconfig.zephyr"
```
